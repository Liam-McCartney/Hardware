// PROJECT    : I2C Data Logger
// PURPOSE    : Logging and displaying temperature data over a 24h period
// AUTHOR     : Liam McCartney
// DATE       : 26/02/23

// REFERENCE  : http://darcy.rsgc.on.ca/ACES/TEI3M/2223/Tasks.html#datalogger
//              https://www.instructables.com/Driving-an-OLED-SSD1306-Display/

#include <Wire.h>

char firstDigitArray[256], secondDigitArray[256];
//Placeholder Arrays for displaying on OLED

unsigned char x, y;
unsigned int z;
//Variables for writing on OLED display

#define RTCADDRESS 0x68
#define completePin 8     //Pin Defintions
#define TC74ADDRESS 0x4D       
#define interruptPin 3


uint8_t dump;
//if eepromRead is being used to print and no return is needed then 'dump' is set the the output

boolean STOP = false;
//Used to stop the programm once 24h has elapsed
uint8_t EEPROM = 0x50;
//Base EEPROM address, will be incremented throughout the programme
uint32_t interruptCount = 0;
//This is the value that stores the time of the current interrupt
uint16_t address = 0x03;
//First address to hold temp/time data is address 3 as the first 3 are used for initial time
uint16_t timeStamp = 0;
//This will be used to store the time of the current address being written to

void setup() {
  Serial.begin(9600);

  pinMode(A2, OUTPUT);  //Switch Pins
  pinMode(A0, OUTPUT);

  digitalWrite(A2, 0);  //More switch pins
  digitalWrite(A0, 1);

  boolean state = digitalRead(A1);
  while (digitalRead(A1) == state)
    ;
  /*
  While the switch does not change, the code does not progress. This makes it so
  that EEPROM is not editted when the ATmega328p gets power, essentially allows for
  a Nano to read the EEPROMs without the mega editting them
  */

  attachInterrupt(digitalPinToInterrupt(interruptPin), increment, CHANGE);
  //Setting up interrupt

  pinMode(completePin, OUTPUT);

  Wire.begin();
  config_lcd(); //Runs code that configures the OLED

  //Configuration code from: https://www.instructables.com/Driving-an-OLED-SSD1306-Display/

  Wire.beginTransmission(RTCADDRESS);
  Wire.write(0x07);       //Edit SQW Config. register
  Wire.write(0b10010000); //Set the SQW to a 1 Hz frequency
  Wire.endTransmission();

  Wire.beginTransmission(RTCADDRESS);
  Wire.write(0);
  Wire.endTransmission();
  Wire.requestFrom(RTCADDRESS, 7); //Requesting all Time info
  while (!Wire.available())
    ;

  uint8_t hours;
  uint8_t minutes;
  uint8_t seconds;
  //Used for initial time-grab

  getTime(hours, minutes, seconds);
  //Sets these variables to the current time

  hours = bcd2dec(hours);
  minutes = bcd2dec(minutes);
  seconds = bcd2dec(seconds);
  //Converts values to decimal (binary acutally)

  eepromWrite(EEPROM, 0x00, bcd2dec(hours));
  eepromWrite(EEPROM, 0x01, bcd2dec(minutes));
  eepromWrite(EEPROM, 0x02, bcd2dec(seconds));
  //Write the start time to EEPROM
}

uint8_t bcd2dec(uint8_t bcd) {
  return 10 * (bcd >> 4) + (bcd & 0xF);
  //Simple bcd to decimal algorithm
}

void getTime(uint8_t &hr, uint8_t &min, uint8_t &sec) {
  sec = Wire.read();
  min = Wire.read();
  hr = Wire.read();
  //Returns without return statement
}

void loop() {
  if (!STOP && (interruptCount % 4) == 0) {
    //Trigger this if statement every fourth interrupt (every 2 seconds)
    boolean startRead = digitalRead(3);
    //Storing the start read

    if (address == 31998) {
      address = 0;
      EEPROM++;
      //Chip roll-over check
    }

    Wire.requestFrom(TC74ADDRESS, 1);  
    while (Wire.available() == 0)
      ;                            
    int8_t celsius = Wire.read();
    //Get Temp data

    float displayTemp;
    digitalRead(A1) ? displayTemp = celsius : displayTemp = celsius * 1.8 + 32;
    //Depending on the state of the switch, the temp is displayed as C or F
    int8_t displayTempInt = int8_t(displayTemp);
    //convert float to integer

    display(displayTempInt); //Display temp on OLED
    
    eepromWrite(EEPROM, address, celsius);
    Serial.print("Temp: ");
    eepromRead(EEPROM, address, dump);
    //Store Temp Data in EEPROM
    address++;

    Serial.println("-----------------");
    Serial.println("Timestamps");

    eepromWrite(EEPROM, address, timeStamp >> 8);
    uint8_t highByte;
    Serial.print("HighByte: ");
    eepromRead(EEPROM, address, highByte);
    //Store highByte of the 2-byte timestamp in EEPROM
    address++;

    eepromWrite(EEPROM, address, timeStamp & 0xFF);
    uint8_t lowByte;
    Serial.print("LowByte: ");
    eepromRead(EEPROM, address, lowByte);
    //Store lowByte of the 2-byte timestamp in EEPROM

    uint16_t collatedStamp = (highBit << 8) | lowBit;
    //Condense the two bytes into one 2-byte number
    Serial.print("TimeStamp: ");
    Serial.println(collatedStamp);

    if (collatedStamp >= 43200) STOP = ~STOP;
    //If over 24h has passed, stop is set to true
    address++;
    timeStamp++;

    Serial.println("-----------------");
    Serial.print("EEPROM Chip: ");
    Serial.println(EEPROM - 0x50 + 1);
    Serial.print("Address: ");
    Serial.println(address);
    Serial.println("-----------------");

    while (digitalRead(3) == startRead)
      ;
    //Prevents multiple logs in one interrupt

  } else if (STOP) {
    //If the period has passed
    Serial.println("Readings Complete!");
    Serial.println("You May Now Run ReadData.ino");
    digitalWrite(completePin, 1);
    //Turn on Complete LED
    while (true)
      ;
  }
}

void eepromWrite(uint8_t chipAddress, uint16_t writeAddress, uint8_t writeData) {
  Wire.beginTransmission(chipAddress);

  Wire.write(writeAddress >> 8);    //Top 8
  Wire.write(writeAddress & 0xFF);  //Bottom 8

  Wire.write(writeData);   //Write Data
  Wire.endTransmission();  //Bye!

  delay(5);  //Let the chip finish its write cycle
}

void eepromRead(uint8_t chipAddress, uint16_t readAddress, uint8_t &returnVar) {
  Wire.beginTransmission(chipAddress);

  Wire.write(writeAddress >> 8);    //Top 8
  Wire.write(writeAddress & 0xFF);  //Bottom 8

  Wire.endTransmission();

  Wire.requestFrom(chipAddress, 1); //Send read request
  while (!Wire.available())
    ;
  int8_t dataRead = Wire.read(); //Set datRead to the desired value

  returnVar = dataRead;
  //Return without return function

  Serial.println(dataRead);
}

void increment() {
  //ISR
  interruptCount++;
}

void send_command(unsigned char cmd) {
  //Part of OLED Config.
  Wire.beginTransmission(0x3c);
  Wire.write(0x00);
  Wire.write(cmd);
  Wire.endTransmission();
}

void config_lcd() {
  //Credit: https://www.instructables.com/Driving-an-OLED-SSD1306-Display/
  Wire.beginTransmission(0x3c);
  Wire.write(0x00);
  Wire.write(0xae);
  Wire.write(0xd5);
  Wire.write(0x80);
  Wire.write(0xa8);
  Wire.endTransmission();
  //
  Wire.beginTransmission(0x3c);
  Wire.write(0x00);
  Wire.write(0x1f);
  Wire.endTransmission();
  //
  Wire.beginTransmission(0x3c);
  Wire.write(0x00);
  Wire.write(0xd3);
  Wire.write(0x00);
  Wire.write(0x40);
  Wire.write(0x8d);
  Wire.endTransmission();
  //
  Wire.beginTransmission(0x3c);
  Wire.write(0x00);
  Wire.write(0x14);
  Wire.endTransmission();
  //
  Wire.beginTransmission(0x3c);
  Wire.write(0x00);
  Wire.write(0x20);
  Wire.write(0x00);
  Wire.write(0xa1);
  Wire.write(0xc8);
  Wire.endTransmission();
  //
  Wire.beginTransmission(0x3c);
  Wire.write(0x00);
  Wire.write(0xda);
  Wire.write(0x02);
  Wire.write(0x81);
  Wire.write(0x8f);
  Wire.endTransmission();
  //
  Wire.beginTransmission(0x3c);
  Wire.write(0x00);
  Wire.write(0xd9);
  Wire.endTransmission();
  //
  Wire.beginTransmission(0x3c);
  Wire.write(0x00);
  Wire.write(0xf1);
  Wire.endTransmission();
  //
  Wire.beginTransmission(0x3c);
  Wire.write(0x00);
  Wire.write(0xdb);
  Wire.write(0x40);
  Wire.write(0xa4);
  Wire.write(0xa6);
  Wire.write(0x2e);
  Wire.write(0xaf);
  Wire.endTransmission();
}

void display(int temp) {
  //This fucntion writes to the OLED display

  void (*setDigitFunctions[10])(int) = { setZero, setOne, setTwo, setThree, setFour, setFive, setSix, setSeven, setEight, setNine };
  //This pointer function avoids a big if() ladder
  //Essentially sets one of the global arrays to a preset array

  int8_t firstDigit = temp / 10;
  int8_t secondDigit = temp - firstDigit * 10;
  //Determining the digits in the temp

  for (uint8_t i = 0; i < 10; i++) {
    if (firstDigit == i || secondDigit == i) {
      //If either digit = i...
      if (firstDigit == i) setDigitFunctions[i](1);
      if (secondDigit == i) setDigitFunctions[i](2);
      //Set the correct array to the preset
    }
  }

  char data[512];
  //This is the variable that will be displayed

  for (int16_t i = 0; i < 256; i++) data[i + 256] = firstDigitArray[i];
  for (int16_t i = 0; i < 256; i++) data[i] = secondDigitArray[i];
  //Sets both halves of the display array

  z = 0;
  for (x = 0; x < 32; ++x) {
    //For every column...
    Wire.beginTransmission(0x3c);
    Wire.write(0x40);
    for (y = 0; y < 16; ++y) {
      //Write every row in that column
      Wire.write(data[z]);
      ++z;
    }
    Wire.endTransmission();  //stop transmitting
  }
}

//The wall of functions...
void setZero(uint8_t placeValue) {
  Serial.println("Setting 0");

  //Preset 0 display, generated using:
  //https://www.mischianti.org/images-to-byte-array-online-converter-cpp-arduino/
  char zero[256] =

    { 0x00, 0x00, 0x00, 0x00, 0x00, 0x00, 0x00, 0x00, 0x00, 0x00, 0x00, 0x00, 0x00, 0x00, 0x00, 0x00,
      0x00, 0x00, 0x00, 0x00, 0x00, 0x00, 0x00, 0x00, 0x00, 0x00, 0x00, 0x00, 0x00, 0x00, 0x00, 0x00,
      0x00, 0x00, 0x00, 0x00, 0x00, 0x00, 0x00, 0x00, 0x00, 0x00, 0x00, 0x00, 0x00, 0x00, 0x00, 0x00,
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      0x00, 0x00, 0x00, 0x00, 0x00, 0x00, 0x00, 0x00, 0x00, 0x00, 0x00, 0x00, 0x00, 0x00, 0x00, 0x00 };


  for (uint16_t i = 0; i < 256; i++) placeValue == 1 ? firstDigitArray[i] = zero[i] : secondDigitArray[i] = zero[i];
  //Set the correct array to the preset array
}
//All the following functions follow the same format

void setOne(uint8_t placeValue) {
  Serial.println("Setting 1");
  char one[256] =

    { 0x00, 0x00, 0x00, 0x00, 0x00, 0x00, 0x00, 0x00, 0x00, 0x00, 0x00, 0x00, 0x00, 0x00, 0x00, 0x00,
      0x00, 0x00, 0x00, 0x00, 0x00, 0x00, 0x00, 0x00, 0x00, 0x00, 0x00, 0x00, 0x00, 0x00, 0x00, 0x00,
      0x00, 0x00, 0x00, 0x00, 0x00, 0x00, 0x00, 0x00, 0x00, 0x00, 0x00, 0x00, 0x00, 0x00, 0x00, 0x00,
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      0x00, 0x00, 0x00, 0x00, 0x00, 0x00, 0x00, 0x00, 0x00, 0x00, 0x00, 0x00, 0x00, 0x00, 0x00, 0x00 };


  for (uint16_t i = 0; i < 256; i++) placeValue == 1 ? firstDigitArray[i] = one[i] : secondDigitArray[i] = one[i];
}

void setTwo(uint8_t placeValue) {
  Serial.println("Setting 2");
  char two[256] =

    { 0x00, 0x00, 0x00, 0x00, 0x00, 0x00, 0x00, 0x00, 0x00, 0x00, 0x00, 0x00, 0x00, 0x00, 0x00, 0x00,
      0x00, 0x00, 0x00, 0x00, 0x00, 0x00, 0x00, 0x00, 0x00, 0x00, 0x00, 0x00, 0x00, 0x00, 0x00, 0x00,
      0x00, 0x00, 0x00, 0x00, 0x00, 0x00, 0x00, 0x00, 0x00, 0x00, 0x00, 0x00, 0x00, 0x00, 0x00, 0x00,
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      0x00, 0x00, 0x00, 0x00, 0x00, 0x00, 0x00, 0x00, 0x00, 0x00, 0x00, 0x00, 0x00, 0x00, 0x00, 0x00 };


  for (uint16_t i = 0; i < 256; i++) placeValue == 1 ? firstDigitArray[i] = two[i] : secondDigitArray[i] = two[i];
}

void setThree(uint8_t placeValue) {
  Serial.println("Setting 3");
  char three[256] =

    { 0x00, 0x00, 0x00, 0x00, 0x00, 0x00, 0x00, 0x00, 0x00, 0x00, 0x00, 0x00, 0x00, 0x00, 0x00, 0x00,
      0x00, 0x00, 0x00, 0x00, 0x00, 0x00, 0x00, 0x00, 0x00, 0x00, 0x00, 0x00, 0x00, 0x00, 0x00, 0x00,
      0x00, 0x00, 0x00, 0x00, 0x00, 0x00, 0x00, 0x00, 0x00, 0x00, 0x00, 0x00, 0x00, 0x00, 0x00, 0x00,
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      0x00, 0x00, 0x00, 0x00, 0x00, 0x00, 0x00, 0x00, 0x00, 0x00, 0x00, 0x00, 0x00, 0x00, 0x00, 0x00 };


  for (uint16_t i = 0; i < 256; i++) placeValue == 1 ? firstDigitArray[i] = three[i] : secondDigitArray[i] = three[i];
}

void setFour(uint8_t placeValue) {
  Serial.println("Setting 4");
  char four[256] =

    { 0x00, 0x00, 0x00, 0x00, 0x00, 0x00, 0x00, 0x00, 0x00, 0x00, 0x00, 0x00, 0x00, 0x00, 0x00, 0x00,
      0x00, 0x00, 0x00, 0x00, 0x00, 0x00, 0x00, 0x00, 0x00, 0x00, 0x00, 0x00, 0x00, 0x00, 0x00, 0x00,
      0x00, 0x00, 0x00, 0x00, 0x00, 0x00, 0x00, 0x00, 0x00, 0x00, 0x00, 0x00, 0x00, 0x00, 0x00, 0x00,
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      0x00, 0x00, 0x00, 0x00, 0x00, 0x00, 0x00, 0x00, 0x00, 0x00, 0x00, 0x00, 0x00, 0x00, 0x00, 0x00 };


  for (uint16_t i = 0; i < 256; i++) placeValue == 1 ? firstDigitArray[i] = four[i] : secondDigitArray[i] = four[i];
}

void setFive(uint8_t placeValue) {
  Serial.println("Setting 5");
  char five[256] =

    { 0x00, 0x00, 0x00, 0x00, 0x00, 0x00, 0x00, 0x00, 0x00, 0x00, 0x00, 0x00, 0x00, 0x00, 0x00, 0x00,
      0x00, 0x00, 0x00, 0x00, 0x00, 0x00, 0x00, 0x00, 0x00, 0x00, 0x00, 0x00, 0x00, 0x00, 0x00, 0x00,
      0x00, 0x00, 0x00, 0x00, 0x00, 0x00, 0x00, 0x00, 0x00, 0x00, 0x00, 0x00, 0x00, 0x00, 0x00, 0x00,
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      0x00, 0x00, 0x00, 0x00, 0x00, 0x00, 0x00, 0x00, 0x00, 0x00, 0x00, 0x00, 0x00, 0x00, 0x00, 0x00 };


  for (uint16_t i = 0; i < 256; i++) placeValue == 1 ? firstDigitArray[i] = five[i] : secondDigitArray[i] = five[i];
}

void setSix(uint8_t placeValue) {
  Serial.println("Setting 6");
  char six[256] =

    { 0x00, 0x00, 0x00, 0x00, 0x00, 0x00, 0x00, 0x00, 0x00, 0x00, 0x00, 0x00, 0x00, 0x00, 0x00, 0x00,
      0x00, 0x00, 0x00, 0x00, 0x00, 0x00, 0x00, 0x00, 0x00, 0x00, 0x00, 0x00, 0x00, 0x00, 0x00, 0x00,
      0x00, 0x00, 0x00, 0x00, 0x00, 0x00, 0x00, 0x00, 0x00, 0x00, 0x00, 0x00, 0x00, 0x00, 0x00, 0x00,
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      0x00, 0x00, 0x00, 0x00, 0x00, 0x00, 0x00, 0x00, 0x00, 0x00, 0x00, 0x00, 0x00, 0x00, 0x00, 0x00 };


  for (uint16_t i = 0; i < 256; i++) placeValue == 1 ? firstDigitArray[i] = six[i] : secondDigitArray[i] = six[i];
}

void setSeven(uint8_t placeValue) {
  Serial.println("Setting 7");
  char seven[256] =

    { 0x00, 0x00, 0x00, 0x00, 0x00, 0x00, 0x00, 0x00, 0x00, 0x00, 0x00, 0x00, 0x00, 0x00, 0x00, 0x00,
      0x00, 0x00, 0x00, 0x00, 0x00, 0x00, 0x00, 0x00, 0x00, 0x00, 0x00, 0x00, 0x00, 0x00, 0x00, 0x00,
      0x00, 0x00, 0x00, 0x00, 0x00, 0x00, 0x00, 0x00, 0x00, 0x00, 0x00, 0x00, 0x00, 0x00, 0x00, 0x00,
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      0x00, 0x00, 0x00, 0x00, 0x00, 0x00, 0x00, 0x00, 0x00, 0x00, 0x00, 0x00, 0x00, 0x00, 0x00, 0x00 };


  for (uint16_t i = 0; i < 256; i++) placeValue == 1 ? firstDigitArray[i] = seven[i] : secondDigitArray[i] = seven[i];
}

void setEight(uint8_t placeValue) {
  Serial.println("Setting 8");
  char eight[256] =

    { 0x00, 0x00, 0x00, 0x00, 0x00, 0x00, 0x00, 0x00, 0x00, 0x00, 0x00, 0x00, 0x00, 0x00, 0x00, 0x00,
      0x00, 0x00, 0x00, 0x00, 0x00, 0x00, 0x00, 0x00, 0x00, 0x00, 0x00, 0x00, 0x00, 0x00, 0x00, 0x00,
      0x00, 0x00, 0x00, 0x00, 0x00, 0x00, 0x00, 0x00, 0x00, 0x00, 0x00, 0x00, 0x00, 0x00, 0x00, 0x00,
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      0x00, 0x00, 0x00, 0x00, 0x00, 0x00, 0x00, 0x00, 0x00, 0x00, 0x00, 0x00, 0x00, 0x00, 0x00, 0x00 };


  for (uint16_t i = 0; i < 256; i++) placeValue == 1 ? firstDigitArray[i] = eight[i] : secondDigitArray[i] = eight[i];
}

void setNine(uint8_t placeValue) {
  Serial.println("Setting 9");
  char nine[256] =

    { 0x00, 0x00, 0x00, 0x00, 0x00, 0x00, 0x00, 0x00, 0x00, 0x00, 0x00, 0x00, 0x00, 0x00, 0x00, 0x00,
      0x00, 0x00, 0x00, 0x00, 0x00, 0x00, 0x00, 0x00, 0x00, 0x00, 0x00, 0x00, 0x00, 0x00, 0x00, 0x00,
      0x00, 0x00, 0x00, 0x00, 0x00, 0x00, 0x00, 0x00, 0x00, 0x00, 0x00, 0x00, 0x00, 0x00, 0x00, 0x00,
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      0x00, 0x00, 0x00, 0x00, 0x00, 0x00, 0x00, 0x00, 0x00, 0x00, 0x00, 0x00, 0x00, 0x00, 0x00, 0x00 };

  for (uint16_t i = 0; i < 256; i++) placeValue == 1 ? firstDigitArray[i] = nine[i] : secondDigitArray[i] = nine[i];
}